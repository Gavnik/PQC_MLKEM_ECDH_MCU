## CMakeLists.txt
```
# CMakeLists.txt -- Zephyr application: ML-KEM vs ECDH benchmark.
# ONE app for all four CPU cores (RP2350 Cortex-M33 and Hazard3, PSoC 62 Cortex-M4F,
# ESP32-S3 Xtensa LX7), selected only by -b.
cmake_minimum_required(VERSION 3.20.0)
set(ZEPHYR_EXTRA_MODULES $ENV{HOME}/zephyrproject/modules/crypto/wolfssl)
find_package(Zephyr REQUIRED HINTS $ENV{ZEPHYR_BASE})
include(${CMAKE_CURRENT_SOURCE_DIR}/cmake/hyb_relocate.cmake)
project(pqc_bench_zephyr)

target_sources(app PRIVATE src/main.c)
target_include_directories(app PRIVATE src)

# --- wolfSSL configuration -------------------------------------------------------
# Zephyr's wolfSSL Kconfig does NOT expose ML-KEM, so we supply src/user_settings.h and
# tell wolfSSL to honour it. Without this the module compiles WITHOUT ML-KEM and the
# benchmark fails at runtime (or, worse, TLS quietly negotiates a classical group).
# NOTE: do NOT define WOLFSSL_USER_SETTINGS here. wolfSSL's Zephyr module uses its own
# mechanism: CONFIG_WOLFSSL_SETTINGS_FILE (set in prj.conf) makes it define
# WOLFSSL_SETTINGS_FILE="src/user_settings.h" and adds the app's src/ to the include
# path. Defining WOLFSSL_USER_SETTINGS too would conflict (two settings mechanisms).
zephyr_include_directories(${CMAKE_CURRENT_SOURCE_DIR}/src)

# --- PSoC62 (Infineon CAT1A) HW TRNG: compile the one PDL crypto-core source that
# cyhal_trng_generate() calls (Cy_Crypto_Core_Trng). hal_infineon doesn't pull it in (no crypto
# DT node), so we add just this file. Cy_Crypto_Core_Enable + hw layer are already compiled
# (only _Trng was undefined), so nothing else is added -> no duplicate symbols.
if(CONFIG_SOC_FAMILY_INFINEON_CAT1A)
  set(_pdl $ENV{HOME}/zephyrproject/modules/hal/infineon/mtb-pdl-cat1/drivers/source)
  target_sources(app PRIVATE
    ${_pdl}/cy_crypto_core_trng.c
    ${_pdl}/cy_crypto_core_hw.c
    ${_pdl}/cy_crypto_core_hw_v1.c)
  set_source_files_properties(
    ${_pdl}/cy_crypto_core_trng.c ${_pdl}/cy_crypto_core_hw.c
    ${_pdl}/cy_crypto_core_hw_v1.c
    PROPERTIES COMPILE_FLAGS "-Wno-error")
endif()
include(${CMAKE_CURRENT_SOURCE_DIR}/cmake/rp2350_time_critical.cmake)
include(${CMAKE_CURRENT_SOURCE_DIR}/cmake/opt_split.cmake OPTIONAL)
```

## Kconfig
```
# Application Kconfig for the PQC benchmark.
# A Kconfig file in the application root becomes the root of the Kconfig tree, so it MUST
# source the Zephyr Kconfig first (keeps every normal symbol available), then add ours.
source "Kconfig.zephyr"

config PQC_WX
	bool "Apply our own boot-time W^X (RP2350 Hazard3 PMP / ESP32-S3 PMS)"
	default n
	help
	  For the two cores whose memory protection is NOT Zephyr's MPU driver. When y, main()
	  applies W^X once at boot, before any benchmark command:
	    hz3 (RP2350 Hazard3): LOCKED NAPOT PMP entries -- relocated crypto code R+X,
	      relocated crypto tables R only, rest of SRAM R+W no-exec, flash XIP R+X
	      (RP2350 erratum E6 R<->X swap applied). The RP2350 port enables no Zephyr PMP,
	      and Zephyr's generic PMP driver cannot express this policy on this core (its
	      no-execute background would be broken by E6; it knows no relocated blocks).
	    lx7 (ESP32-S3): PMS via Espressif's header-only memprot_ll helpers -- IRAM code R+X,
	      the crypto tables block in DRAM R only (DRAM0 split lines D_0/D_1), rest of DRAM
	      R+W, no execute from the data side.
	  Set in the hz3 and ESP32 board confs so flash AND hybrid images are protected, matching
	  the Arm cores (Zephyr MPU on in every build). The firmware reports what is live as wx=.
	  Ignored on Cortex-M.

config PQC_FETCHTEST
	bool "Arm diagnostic: instruction-fetch cost from flash vs SRAM (console 'fetchtest')"
	default n
	help
	  Diagnostic image only, never a measured image. Adds small timing kernels to main.c, each
	  compiled twice (flash .text and __ramfunc SRAM), plus the same load/store loops with the
	  data in other SRAM banks, to find out why the PSoC 62 Cortex-M4 runs the crypto SLOWER
	  from SRAM than from flash, and whether the RP2350 Cortex-M33 shows the same effect.
	  Cortex-M4 and Cortex-M33 only.

config PQC_CRYPTO_IN_IRAM
	bool "Place the wolfSSL crypto working set in internal SRAM (IRAM/DRAM)"
	default n
	help
	  Placement experiment (RQ1, ESP32-S3). When y, the SoC linker pulls the wolfSSL crypto
	  objects' .text/.literal into IRAM and their .rodata into DRAM instead of executing from
	  flash via the instruction cache. Requires the matching esp32s3/default.ld input-section
	  patch (guarded on this symbol). Ignored on non-Xtensa targets.
```

## prj.conf
```kconfig
# prj.conf -- common Kconfig for the PQC KEM benchmark (all boards).
# Board-specific bits (WiFi driver, static IP) live in boards/<board>.conf overlays.
#
# IMPORTANT: wolfSSL's Zephyr module does NOT expose per-feature Kconfig symbols
# (no CONFIG_WOLFSSL_HASH_SHA256, etc). ALL crypto configuration -- ML-KEM, TLS 1.3,
# ECDSA, AES-GCM, SHA-2/3, curve25519 -- is done in src/user_settings.h, which the
# CMakeLists wires in via WOLFSSL_USER_SETTINGS. So this file only turns the module
# ON and configures the OS (console, heap, timing, networking).
#
# Kconfig rule learned the hard way: NO inline "# comment" on a value line -- Zephyr
# parses it as part of the value and aborts. Comments go on their own line only.

# ---------- console / command channel ----------
CONFIG_CONSOLE=y
# CONSOLE_SUBSYS + CONSOLE_GETLINE provide console_getline()/console_getline_init()
# that main.c uses for the blocking, newline-terminated command reader.
CONFIG_CONSOLE_SUBSYS=y
CONFIG_CONSOLE_GETLINE=y
CONFIG_SERIAL=y
CONFIG_UART_CONSOLE=y
CONFIG_PRINTK=y
CONFIG_STDOUT_CONSOLE=y

# ---------- C library / heap / stacks ----------
# The stats core prints doubles with %.4f. picolibc is the default libc on RP2350, and
# it needs its OWN float-printf switch. (We previously set NEWLIB_LIBC_FLOAT_PRINTF, but
# picolibc won the libc choice, so that newlib flag was ignored -> printed "*float*".)
# PICOLIBC_IO_FLOAT enables %f/%e/%g in printf/snprintf.
CONFIG_REQUIRES_FULL_LIBC=y
CONFIG_PICOLIBC=y
CONFIG_PICOLIBC_IO_FLOAT=y
CONFIG_CBPRINTF_FP_SUPPORT=y
# ML-KEM + TLS need a generous main stack
CONFIG_MAIN_STACK_SIZE=32768
# HEAPS. wolfSSL allocates through libc malloc -> COMMON_LIBC_MALLOC_ARENA_SIZE (64 KB on every
# board; measured wolfSSL peak 18.9 KB, P-521 derive). HEAP_MEM_POOL_SIZE is the kernel k_malloc
# pool, not used by wolfSSL (the ESP32 L1 conf lowers it to 16 KB to fit the hybrid image).
# History: a hang once blamed on heap size was a key-object leak, fixed in the op functions
# (Free + re-Init of the ML-KEM key).
CONFIG_HEAP_MEM_POOL_SIZE=65536
CONFIG_COMMON_LIBC_MALLOC_ARENA_SIZE=65536

# ---------- timing ----------
# Tick rate 1000 Hz (1 ms). Layer 1 does NOT mask interrupts across a timed op (masking wedged
# the USB-CDC console); the tick ISR is ~0.1% of an op and identical on every board.
CONFIG_SYS_CLOCK_TICKS_PER_SEC=1000

# wolfSSL's wc_port.c (WOLFSSL_ZEPHYR path) tries an RTC device, then falls back to
# POSIX clock_gettime(). The Pico has no ready RTC node, so it hits the fallback.
# POSIX_TIMERS provides the clock_gettime IMPLEMENTATION; POSIX_API exposes its
# DECLARATION (prototype in <time.h>) so wc_port.c compiles. Need BOTH.
# (Keeping a real time source -- rather than NO_ASN_TIME -- keeps MCU wolfSSL behaviour
# aligned with the Pi build.)
# NOTE: if the build aborts with "undefined symbol POSIX_TIMERS", your Zephyr uses the
# older name: use CONFIG_POSIX_CLOCK=y instead of POSIX_TIMERS.
CONFIG_POSIX_API=y
CONFIG_POSIX_TIMERS=y



# ---------- console TX robustness (prevent USB-CDC wedge under output load) ----------
# Symptom: over a long run the board hung mid-print (e.g. "PROG roun"), and MORE output
# made it hang SOONER -> the USB-CDC console TX path was wedging when its buffer filled
# and printk blocked. Enable interrupt-driven UART with a generous TX ring buffer so
# printk never blocks waiting on a full CDC buffer.
CONFIG_UART_INTERRUPT_DRIVEN=y
CONFIG_UART_CONSOLE_MCUMGR=n
CONFIG_LOG=n
CONFIG_CBPRINTF_NANO=n

# ---------- watchdog: DISABLE for benchmarking ----------
# The RP2350 enables a hardware watchdog by default. It auto-resets the board if not
# "fed" within its timeout. Our long compute runs (1000 iters x 5 rounds of ML-KEM =
# ~28 s of near-continuous crypto) exceed that timeout and the board RESETS mid-run
# (observed: reboot banner, no output). We keep the watchdog DRIVER compiled in but tell
# Zephyr to actively DISABLE the hardware watchdog at boot -- this reliably turns off a
# HW watchdog that the bootloader/ROM may have started, which a bare CONFIG_WATCHDOG=n
# would not do. A benchmark has no use for a watchdog.
CONFIG_WATCHDOG=y
CONFIG_WDT_DISABLE_AT_BOOT=y

# ---------- entropy / RNG ----------
CONFIG_ENTROPY_GENERATOR=y
CONFIG_TEST_RANDOM_GENERATOR=n

# ---------- wolfSSL (external module: modules/crypto/wolfssl) ----------
# Enable the module, build from its integrated sources, turn on ML-KEM via the
# module's own Kconfig, and point it at our settings file for the remaining options
# (TLS 1.3, ECDSA, AES-GCM, SHA-2/3, curve25519). The module adds
# ${APPLICATION_CONFIG_DIR}/src to the include path when SETTINGS_FILE is set, so the
# path below is relative to this app dir.
CONFIG_WOLFSSL=y
CONFIG_WOLFSSL_BUILTIN=y
CONFIG_WOLFSSL_MLKEM=y
CONFIG_WOLFSSL_SETTINGS_FILE="src/user_settings.h"
# picolibc on these targets does NOT provide min()/max(), but the module otherwise
# injects -DWOLFSSL_HAVE_MIN/MAX (Zephyr >= 4.3), which tells wolfSSL to SKIP defining
# its own -> "implicit declaration of function 'min'" across many wolfcrypt sources.
# Setting this makes the module omit those defines so wolfSSL supplies min/max itself.
CONFIG_WOLFSSL_NO_HAVE_MIN_MAX=y

# ---------- drop mbedTLS everywhere (we use wolfSSL exclusively) ----------
# Zephyr links mbedTLS as its default TLS/crypto backend. We use wolfSSL for ALL crypto,
# so mbedTLS is dead weight (~50-70 KB) -- it must be disabled on every board (the Pico
# has even less RAM than the ESP32). We keep Zephyr's TLS-socket option OFF because our
# TLS is done directly through wolfSSL, not through Zephyr's mbedTLS-backed tls sockets.
CONFIG_MBEDTLS=n
CONFIG_NET_SOCKETS_SOCKOPT_TLS=n

# ---------- networking (Layer 2) ----------
CONFIG_NETWORKING=y
CONFIG_NET_IPV4=y
CONFIG_NET_IPV6=n
CONFIG_NET_TCP=y
CONFIG_NET_SOCKETS=y
CONFIG_NET_CONNECTION_MANAGER=y
CONFIG_NET_PKT_RX_COUNT=16
CONFIG_NET_PKT_TX_COUNT=16
CONFIG_NET_BUF_RX_COUNT=32
CONFIG_NET_BUF_TX_COUNT=32
CONFIG_NET_MAX_CONTEXTS=8

# Static IP (overridden per board in boards/*.conf)
CONFIG_NET_CONFIG_SETTINGS=y
CONFIG_NET_CONFIG_NEED_IPV4=y
CONFIG_NET_CONFIG_MY_IPV4_GW="192.0.2.1"
CONFIG_NET_CONFIG_MY_IPV4_NETMASK="255.255.255.0"


# ---------- mem mode: thread stack high-water measurement ----------
# INIT_STACKS paints thread stacks with a known pattern; THREAD_STACK_INFO exposes the
# stack bounds; together they let k_thread_stack_space_get() report unused bytes, from
# which we derive the peak stack used by one ML-KEM op (mirrors the Pi's painted-stack
# method). THREAD_MONITOR + THREAD_NAME help the analyzer.
CONFIG_INIT_STACKS=y
CONFIG_THREAD_STACK_INFO=y
CONFIG_THREAD_MONITOR=y

# ---------- optimization level (EXPLICIT + identical across all boards) ----------
# SPLIT, the same on every board (2026-11-10):
#   wolfSSL (all 104 sources) + src/main.c (the timing harness) : -O2  (cmake/opt_split.cmake)
#   Zephyr kernel, drivers, libc                                : -Os  (this line, Zephyr default)
# -O2 for the crypto = what wolfSSL's own configure picks for SP math without SP_SMALL (our
# setup). Zephyr itself stays at its default -Os because the whole-image -O2 build of the RP2350
# Cortex-M33 does not enumerate on USB (bisected: fails at -O2 with the MPU off and with the stack
# guard off; boots with Zephyr at -Os and wolfSSL + main.c at -O2). The timed region is wolfSSL code
# + the harness, so the measured crypto is -O2 on every board. Self-reported as opt=split-O2.
CONFIG_SIZE_OPTIMIZATIONS=y
```

## boards/cy8cproto_062_4343w.conf
```kconfig
# PSoC62 (CY8CPROTO-062-4343W, Cortex-M4F / CY8C624ABZI-S2D44) wolfCrypt tuning.
#
# PURPOSE: the asm-ON build of the m4, identical in intent to the m33 asm-ON build. The PSoC6 M4
# is ARMv7E-M (Thumb-2), so the same wolfSSL Cortex-M assembly applies:
#   * Thumb-2 asm for ML-KEM (NTT/basemul), SHA-3/SHAKE, X25519 and SHA-256 (port/arm/thumb2-*,
#     enabled by user_settings.h under CONFIG_WOLFCRYPT_ARMASM + _THUMB2: WOLFSSL_ARMASM,
#     ARMASM_THUMB2, ARMASM_INLINE, ARMASM_NO_NEON, ARMASM_NO_HW_CRYPTO, NO_HASH_RAW);
#   * SP Cortex-M asm for P-256/384/521 (sp_cortexm.c, WOLFSSL_SP_ARM_CORTEX_M_ASM).
#   Verified 2026-11-06 (notes §7-8): ML-KEM-768 decaps -18%, X25519 derive 2.9x vs asm-off.
#   (An earlier note here said ML-KEM had no wolfSSL asm: wrong -- the Thumb-2 asm was simply never
#   enabled before, because our user_settings.h replaced the module's.)
# Self-reports asm=on. The asm-off control is config/overlay-asmoff.conf (asm=off).
# The MPU (CONFIG_ARM_MPU) and stack protection are on by board default in every m4 image.
#
# This conf is NOT auto-merged by board name here; pass it explicitly alongside the L1-only
# overlay, e.g.:
#   -DEXTRA_CONF_FILE="config/overlay-l1only.conf;boards/cy8cproto_062_4343w.conf"
CONFIG_WOLFCRYPT_ARMASM=y
CONFIG_WOLFCRYPT_ARMASM_THUMB2=y
```

## boards/esp32s3_devkitc_procpu.conf
```kconfig
# ESP32-S3 DevKitC (Xtensa LX7) -- LAYER 1 + LAYER 2 (TLS over WiFi).
#
# The earlier DRAM overflow (~59 KB) came from the common prj.conf's HUGE heap sizes
# (HEAP_MEM_POOL_SIZE=128K + MALLOC_ARENA=128K = 256 KB) which are Pico-tuned. The ESP32
# internal DRAM region is ~399 KB; with WiFi + lwIP + wolfSSL on top, 256 KB of heap
# doesn't fit. Fix: override with realistic sizes here (this conf is merged AFTER
# prj.conf so these win). wolfSSL ML-KEM needs ~40-50 KB peak heap, not 128 KB.
# No PSRAM needed once the heap is right (avoids Zephyr/ESP-IDF PSRAM symbol mismatch).

CONFIG_WIFI=y
CONFIG_WIFI_ESP32=y
CONFIG_NET_L2_ETHERNET=y
CONFIG_NET_DHCPV4=n
CONFIG_NET_CONFIG_MY_IPV4_ADDR="192.0.2.41"

CONFIG_WIFI_CREDENTIALS=y
CONFIG_WIFI_CREDENTIALS_STATIC=y
CONFIG_WIFI_CREDENTIALS_STATIC_SSID="YOUR_SSID"
CONFIG_WIFI_CREDENTIALS_STATIC_PASSWORD="YOUR_PASSWORD"

# NOTE: WiFi power-save disabled at RUNTIME in main.c.
# mbedTLS stays (WiFi driver force-selects it for WPA2); wolfSSL does all our TLS.
CONFIG_MBEDTLS=y

# --- MEMORY: override the Pico-tuned heap (the real overflow cause) ---
CONFIG_NET_PKT_RX_COUNT=8
CONFIG_NET_PKT_TX_COUNT=8
CONFIG_NET_BUF_RX_COUNT=16
CONFIG_NET_BUF_TX_COUNT=16
CONFIG_NET_MAX_CONTEXTS=6
CONFIG_MAIN_STACK_SIZE=24576
```

## boards/esp32s3_devkitc_procpu_l1only.conf
```kconfig
# ESP32-S3 -- LAYER 1 ONLY variant (guaranteed to fit; no WiFi/mbedTLS/lwIP).
# Used by all four measured ESP32 images (radio off, same rationale as the other boards):
#   flash          : -DEXTRA_CONF_FILE="boards/esp32s3_devkitc_procpu_l1only.conf"
#   flash, fast x25519: + ";config/overlay-x25519fast-esp32.conf"
#   hybrid         : + ";config/overlay-iram-esp32.conf"   (run tools/esp32_iram_patch.py first)
#   hybrid, fast   : + ";config/overlay-iram-esp32.conf;config/overlay-x25519fast-esp32.conf"

# --- explicitly NO networking ---
CONFIG_WIFI=n
CONFIG_NETWORKING=n
CONFIG_NET_SOCKETS=n

# wolfSSL sees no sockets (avoid htons implicit-declaration, as on the RISC-V build).
CONFIG_COMPILER_OPT="-DWOLFSSL_NO_SOCK -DWOLFSSL_USER_IO -DNO_WOLFSSL_STUB"

# Main stack 24 KB on the ESP32 (32 KB on the other boards). The fast-curve25519 hybrid image did
# not fit DRAM by 6.6 KB at -O2 even with the 4 KB kernel heap below. The main thread runs the
# console and the timed ops: measured op stack peak <= 1.12 KB (P-521 derive, mem pass), plus
# console/printf, so 24 KB keeps a > 15 KB margin. Stack size does not affect timing. Same value
# in all four ESP32 images.
CONFIG_MAIN_STACK_SIZE=24576
# Kernel heap (k_malloc) 4 KB on the ESP32 (2026-11-10). The hybrid image puts ~200 KB of wolfCrypt
# code + tables into the ONE internal SRAM pool that IRAM and DRAM share. At -O2 (prj.conf
# CONFIG_SPEED_OPTIMIZATIONS, all boards) it overflowed DRAM by 7.4 KB even with 16 KB here.
# wolfSSL does NOT use this heap: its XMALLOC goes to libc malloc (COMMON_LIBC_MALLOC_ARENA_SIZE
# = 64 KB in prj.conf, unchanged and identical on every board; measured wolfSSL peak 18.9 KB).
# With networking off, only small driver allocations use k_malloc. Same value in all four
# ESP32 images (flash and hybrid).
CONFIG_HEAP_MEM_POOL_SIZE=4096

# --- W^X at boot (2026-11-10): our own PMS code (no Zephyr driver exists for it). Flash and
# hybrid images are both protected, like the Arm cores. Self-reports wx=pms.
CONFIG_PQC_WX=y
```

## boards/rpi_pico2_rp2350a_hazard3.conf
```kconfig
# Pico 2 W -- RISC-V (Hazard3) core.  LAYER 1 ONLY.
#
# Zephyr's AIROC/CYW43 WiFi support for the RP2350 targets the Cortex-M33 core, so the
# Hazard3 build has NO networking and therefore NO Layer 2. This is a deliberate,
# documented scope boundary, not an omission: benchmarking the TLS handshake here would
# require a bare-metal RISC-V path, which would reintroduce the very OS confound that
# choosing Zephyr eliminates.
#
# Report it as a finding: "ML-KEM primitives were benchmarked on both RP2350 ISAs;
# TLS handshakes were ARM-only, as Zephyr's CYW43 WiFi support targets the Cortex-M33."

# --- explicitly NO networking on this target ---
CONFIG_WIFI=n
CONFIG_NETWORKING=n
CONFIG_NET_SOCKETS=n

# --- Layer 1 needs only crypto + console ---
# smaller stack than the ARM/WiFi build: no lwIP, no TLS session buffers
CONFIG_MAIN_STACK_SIZE=32768

# wolfSSL sees no networking on this Layer-1-only build. Define WOLFSSL_NO_SOCK on the
# COMMAND LINE (not just user_settings.h) so it is set before any wolfssl header is
# parsed -- avoids "implicit declaration of htons" from wolfio.h due to include ordering.
CONFIG_COMPILER_OPT="-DWOLFSSL_NO_SOCK -DWOLFSSL_USER_IO -DNO_WOLFSSL_STUB"

# --- USB-CDC console (Pico's own USB port becomes /dev/ttyACMx) ---
# The console/command channel goes over USB-CDC, not the UART GPIO pins. Requires the
# USB device stack + CDC-ACM, and the matching boards/<board>.overlay (chosen console).
CONFIG_USB_DEVICE_STACK=y
CONFIG_USB_DEVICE_PRODUCT="PQC-Bench"
CONFIG_USB_CDC_ACM=y
CONFIG_UART_LINE_CTRL=y
# wait for the USB CDC DTR (host opens the port) before printing, so we don't lose lines
CONFIG_USB_DEVICE_INITIALIZE_AT_BOOT=y

# --- W^X at boot (2026-11-10): our own locked PMP map (main.c). The RP2350 port enables no Zephyr
# PMP, and Zephyr's generic driver cannot express this policy on this core (erratum E6 breaks its
# no-execute background). Flash and hybrid images are both protected, like the Arm cores with
# Zephyr's MPU.
# The firmware self-reports wx=pmp when every entry is locked as planned.
CONFIG_PQC_WX=y
```

## boards/rpi_pico2_rp2350a_m33.conf
```kconfig
# Pico 2 W, ARM Cortex-M33 -- WiFi via Infineon CYW43439 (airoc driver).
# NOTE: fetch the WiFi firmware blobs once per workspace:  west blobs fetch hal_infineon
CONFIG_WIFI=y
CONFIG_WIFI_AIROC=y
CONFIG_NET_L2_ETHERNET=y
# static IP for reproducible measurements
CONFIG_NET_DHCPV4=n
CONFIG_NET_CONFIG_MY_IPV4_ADDR="192.0.2.40"

# WiFi credentials (isolated lab network). Set yours here.
CONFIG_WIFI_CREDENTIALS=y
CONFIG_WIFI_CREDENTIALS_STATIC=y
CONFIG_WIFI_CREDENTIALS_STATIC_SSID="YOUR_SSID"
CONFIG_WIFI_CREDENTIALS_STATIC_PASSWORD="YOUR_PASSWORD"

# WiFi power-save is disabled at RUNTIME in main.c via the WiFi mgmt API. Power-save
# adds ~ms wake-up latency per handshake and was the root cause of a 2.6 ms/handshake
# inflation in the Raspberry Pi 4 study. (Runtime disable avoids Kconfig symbol-name
# fragility across Zephyr/driver versions.)

# M33 + TLS1.3 + ML-KEM headroom
CONFIG_MAIN_STACK_SIZE=40960

# --- USB-CDC console (Pico's own USB port becomes /dev/ttyACMx) ---
# The console/command channel goes over USB-CDC, not the UART GPIO pins. Requires the
# USB device stack + CDC-ACM, and the matching boards/<board>.overlay (chosen console).
CONFIG_USB_DEVICE_STACK=y
CONFIG_USB_DEVICE_PRODUCT="PQC-Bench"
CONFIG_USB_CDC_ACM=y
CONFIG_UART_LINE_CTRL=y
# wait for the USB CDC DTR (host opens the port) before printing, so we don't lose lines
CONFIG_USB_DEVICE_INITIALIZE_AT_BOOT=y

# ---------- ARM Thumb-2 assembly for ML-KEM (M33-specific, "best available per core") ----------
# The Cortex-M33 is a Thumb-2 core, and wolfSSL ships hand-optimised Thumb-2 assembly for
# ML-KEM (NTT/basemul) AND for the SHA-3/SHAKE hashing ML-KEM uses internally. Enabling it
# measures the ARM core at its BEST real-world wolfSSL performance -- consistent with the
# Pi, where both libraries use AArch64 assembly. RISC-V Hazard3 and Xtensa LX7 have NO
# ML-KEM assembly in wolfSSL 5.9.2, so they run portable C; this asymmetry is a REPORTED
# methodology choice ("most-optimised build available on each platform"), not a bug.
CONFIG_WOLFCRYPT_ARMASM=y
CONFIG_WOLFCRYPT_ARMASM_THUMB2=y

# ---- WiFi management (needed for net_mgmt(NET_REQUEST_WIFI_CONNECT) to link) ----
# CONFIG_WIFI alone does not pull in the management request handlers; these do.
CONFIG_NET_MGMT=y
CONFIG_NET_MGMT_EVENT=y
CONFIG_NET_L2_WIFI_MGMT=y
```

## boards/rpi_pico2_rp2350a_m33_l1only.conf
```kconfig
# Pico 2 W, ARM Cortex-M33 -- LAYER 1 ONLY variant (NO active WiFi).
#
# WHY THIS EXISTS: for the Layer-1 primitive study we want the SAME environment on every
# board. The RISC-V Hazard3 cannot run WiFi at all (Zephyr's CYW43 driver is M33-only),
# so to keep the cross-board comparison fair we run Layer 1 with networking/radio OFF on
# EVERY board -- including this ARM one, which is perfectly capable of WiFi but has it
# disabled here. A live radio draws power and raises interrupts that would perturb both
# timing and (especially) energy, and would differ from the RISC-V board. Disabling it
# removes that confound: Layer 1 measures the CORE doing crypto, nothing else.
#
# This is an ADDITIVE override conf. It is merged AFTER the auto-applied
# boards/rpi_pico2_rp2350a_m33.conf (the WiFi-on build used for Layer 2), so the =n lines
# below win and switch the radio + net stack off. It does NOT replace or edit that file.
#
# Final measured builds (NON-/w target, so the CYW43 node is not even in the devicetree):
#   flash : -DEXTRA_CONF_FILE="boards/rpi_pico2_rp2350a_m33_l1only.conf;config/overlay-mpu-on.conf;config/overlay-rp2350-noflashcmd.conf"
#   hybrid: -DEXTRA_CONF_FILE="boards/rpi_pico2_rp2350a_m33_l1only.conf;config/overlay-hyb-arm.conf;config/overlay-rp2350-noflashcmd.conf"
#   asm-off: insert config/overlay-asmoff.conf after the l1only conf.
# (wolfSSL is pulled in by the app CMakeLists.txt via ZEPHYR_EXTRA_MODULES.)

# --- explicitly NO networking / NO radio (override the WiFi-on board conf) ---
CONFIG_WIFI=n
CONFIG_WIFI_AIROC=n
CONFIG_NETWORKING=n
CONFIG_NET_SOCKETS=n
CONFIG_NET_L2_ETHERNET=n
CONFIG_NET_MGMT=n
CONFIG_NET_MGMT_EVENT=n
CONFIG_NET_L2_WIFI_MGMT=n
CONFIG_WIFI_CREDENTIALS=n
CONFIG_WIFI_CREDENTIALS_STATIC=n
CONFIG_NET_CONFIG_SETTINGS=n

# wolfSSL sees no sockets on this build: define WOLFSSL_NO_SOCK on the COMMAND LINE (before
# any wolfssl header is parsed) to avoid "implicit declaration of htons" from wolfio.h.
# Identical to the RISC-V and ESP32 Layer-1-only builds.
CONFIG_COMPILER_OPT="-DWOLFSSL_NO_SOCK -DWOLFSSL_USER_IO -DNO_WOLFSSL_STUB"

# Layer 1 needs only crypto + console; match the other L1-only builds' stack.
CONFIG_MAIN_STACK_SIZE=32768

# ---------- wolfSSL Arm assembly ON (asm=on); overlay-asmoff.conf gives the asm=off control ----------
CONFIG_WOLFCRYPT_ARMASM=y
CONFIG_WOLFCRYPT_ARMASM_THUMB2=y

# ---------- KEEP the USB-CDC console (command/data channel over the Pico's USB port) ----------
CONFIG_USB_DEVICE_STACK=y
CONFIG_USB_DEVICE_PRODUCT="PQC-Bench"
CONFIG_USB_CDC_ACM=y
CONFIG_UART_LINE_CTRL=y
CONFIG_USB_DEVICE_INITIALIZE_AT_BOOT=y
```

## boards/cy8cproto_062_4343w_cy8c624abzi_s2d44.overlay
```dts
/* PSoC 62 Cortex-M4 image: keep clear of the Cortex-M0+ core's RAM (2026-11-11).
 *
 * The board boots the prebuilt M0+ "sleep" image first (CONFIG_SOC_PSOC6_CM0P_IMAGE_SLEEP=y,
 * CONFIG_SOC_PSOC6_CM0P_IMAGE_RAM_SIZE=0x2000). That image's initial stack pointer is 0x08002000
 * (seen by OpenOCD at reset), i.e. it owns SRAM 0x08000000..0x08001FFF. Stock Zephyr gives the M4
 * the whole 1 MB from 0x08000000, so every M4 image placed its own RAM there -- in the hybrid, the
 * first 8 KB of the crypto code block. The M4's MPU cannot stop the other core, so "read-only
 * crypto code" was not guaranteed against it. The M4 now starts at 0x08002000, the same split
 * Infineon's own dual-core layouts use. Applied automatically to every build for this board target.
 * (The unit address in the node name stays memory@8000000; dtc may warn about it -- harmless.) */
&sram0 {
	reg = <0x08002000 0xFE000>;
};
```

## boards/rpi_pico2_rp2350a_hazard3.overlay
```dts
/* USB-CDC console for the RISC-V build too. */
&usbd {
    status = "okay";
    cdc_acm_uart0: cdc_acm_uart0 {
        compatible = "zephyr,cdc-acm-uart";
    };
};

/ {
    chosen {
        zephyr,console = &cdc_acm_uart0;
        zephyr,shell-uart = &cdc_acm_uart0;
    };
};
```

## boards/rpi_pico2_rp2350a_m33.overlay
```dts
/* USB-CDC console: make the Pico's own USB port a serial device (/dev/ttyACMx).
 * RP2350 USB device controller node is &usbd (confirmed in rp2350.dtsi). */
&usbd {
    status = "okay";
    cdc_acm_uart0: cdc_acm_uart0 {
        compatible = "zephyr,cdc-acm-uart";
    };
};

/ {
    chosen {
        zephyr,console = &cdc_acm_uart0;
        zephyr,shell-uart = &cdc_acm_uart0;
    };
};
```

## src/mcu_measure_core.h
```c
#include <zephyr/kernel.h>   /* k_sleep() to let lower-prio system threads run */
/* mcu_measure_core.h -- shared Layer 1 / Layer 2 measurement core for MCUs
 * (Raspberry Pi Pico 2 W  RP2350  ARM Cortex-M33 or RISC-V Hazard3,
 *  Espressif ESP32-S3     Xtensa LX7).
 *
 * DESIGN GOAL: emit the SAME "ROUND ..." and "AGG ..." lines as the Raspberry
 * Pi 4 harness (measure_core.h / l2_core.h) so the SAME Python parser
 * (pqcbench.py) ingests MCU results with ZERO changes. Only the transport
 * differs: the Pi prints to stdout over SSH; the MCU prints to UART/USB-CDC.
 *
 * The board-specific layer must provide:
 *    uint64_t mcu_now_us(void);     // monotonic microseconds
 *    void     mcu_print(const char*);// write a line to UART/USB-CDC
 *    (RNG + wolfCrypt are provided by the wolfSSL port for each board.)
 *
 * Philosophy parity with the Pi harness:
 *   - Layer 1: iters mode = fixed iteration count, warmup, N rounds; report
 *     per-round mean/sd/min/med/p95/max in MICROSECONDS (us_*), plus an AGG line
 *     with across-round mean/sd. (Same as Pi measure_core.h.)
 *   - Layer 2: iters mode = fixed handshake count, warmup, N rounds; report
 *     per-round ms_* and an AGG line. (Same as Pi l2_core.h.)
 *   - time/energy mode: run for a wall-clock window, emit PAIR_WITH_METER so the
 *     external SUNSHINE/PPK2 meter reading lines up with a known op count.
 */
#ifndef MCU_MEASURE_CORE_H
#define MCU_MEASURE_CORE_H
#include <stdint.h>
#include <stdio.h>
#include <string.h>
#include <math.h>

/* ---- board hooks (defined in the board main) ---- */
uint64_t mcu_now_us(void);
void     mcu_print(const char *s);

/* ---- small print helper: build a line then emit it ---- */
static char _mcu_line[256];
#define MCU_EMIT(...) do{ snprintf(_mcu_line,sizeof _mcu_line,__VA_ARGS__); mcu_print(_mcu_line);}while(0)

/* ---- sorting + percentiles over uint64 samples (times in ns) ---- */
static int _mcu_cmp_u64(const void*a,const void*b){
    uint64_t x=*(const uint64_t*)a,y=*(const uint64_t*)b; return (x>y)-(x<y);
}

/* ---- cooperative yield (outside every timed region) ----
 * The benchmark runs in main() at a priority >= the system threads, so it must periodically
 * BLOCK (k_sleep) so lower-priority threads (USB-CDC, the watchdog feeder) get CPU time; on the
 * RP2350 a long enough no-yield window wedges/resets the board (documented in main(): ~25-28 s).
 * The original rule -- sleep 1 ms every 64 ops -- assumed ms-scale ops. For SLOW ops it leaves a
 * huge no-yield window: Hazard3 p521 derive is ~380 ms/op, so 10 warmup + 64 timed ops (+2 setup
 * keygens) = ~28.7 s without a yield -> board went silent; the identical chip on M33 at 335 ms/op
 * (~25.3 s) survived. So we ALSO yield once MCU_YIELD_MAX_MS of wall-clock has passed since the
 * last yield. For fast ops the 64-op rule always fires first, so their behavior is unchanged;
 * only ops slower than ~MCU_YIELD_MAX_MS/64 gain an extra (1 ms, untimed) yield.
 * The yield happens BETWEEN ops; each op records its own elapsed time internally, so no
 * measurement includes it. */
#ifndef MCU_YIELD_MAX_MS
#define MCU_YIELD_MAX_MS 10000
#endif
static int64_t _mcu_last_yield_ms;
static inline void mcu_yield_reset(void) { _mcu_last_yield_ms = k_uptime_get(); }
static inline void _mcu_do_yield(void)   { k_sleep(K_MSEC(1)); _mcu_last_yield_ms = k_uptime_get(); }
/* op-count OR wall-clock rule (Layer-1/2 loops) */
static inline void mcu_maybe_yield(long i)
{
    if (((i & 0x3F) == 0x3F) || (k_uptime_get() - _mcu_last_yield_ms >= MCU_YIELD_MAX_MS))
        _mcu_do_yield();
}
/* wall-clock-only rule (energy window: keeps idle time ~0.01% so energy/op is undisturbed) */
static inline void mcu_maybe_yield_time(void)
{
    if (k_uptime_get() - _mcu_last_yield_ms >= MCU_YIELD_MAX_MS) _mcu_do_yield();
}

/* A single "operation" returns 0 on success and writes elapsed nanoseconds to *ns.
 * For Layer 1 this is one keygen/encaps/decaps; for Layer 2 one full handshake. */
typedef int (*mcu_op_fn)(void *ctx, uint64_t *ns);

/* Optional per-round reset hook: called BEFORE each round (outside the timed region).
 * Used to Free+re-Init the crypto context between rounds so that any per-call internal
 * allocation in the crypto library cannot accumulate across a long multi-round run
 * (observed: ML-KEM keygen leaked/exhausted the heap around ~5000 total ops -> board
 * hung). Returns 0 on success. Pass NULL if no reset is needed. */
typedef int (*mcu_reset_fn)(void *ctx);

/* Shared runner. unit_is_ms=0 -> Layer 1 (report us_*), unit_is_ms=1 -> Layer 2 (ms_*).
 * label = the group/phase string that appears in the output line. */
static void mcu_run(const char *label, int unit_is_ms,
                    long count, long rounds, long warmup,
                    mcu_op_fn op, void *ctx,
                    uint64_t *scratch /* size >= count */,
                    mcu_reset_fn reset /* may be NULL */)
{
    /* warmup (not timed, not printed) */
    mcu_yield_reset();
    for (long i=0;i<warmup;i++){ uint64_t t; op(ctx,&t); mcu_maybe_yield(i); }

    double *central = (double*)0; /* avoid malloc; track across-round on the fly */
    double ar_mean=0, ar_M2=0; long ar_n=0;

    for (long r=0;r<rounds;r++){
        /* reset the crypto context between rounds to stop cross-round heap accumulation */
        if (reset && reset(ctx) != 0) {
            MCU_EMIT("ROUND %ld group=%s ok=0 RESET_FAILED", r, label);
            continue;
        }
        long n=0, discarded=0, failed=0;
        for (long i=0;i<count;i++){
            uint64_t t;
            int rc = op(ctx,&t);
            if (rc == 0)        scratch[n++]=t;   /* good sample */
            else if (rc == -2)  discarded++;      /* op >= 25 s: dual-clock discard */
            else                failed++;         /* crypto/socket failure */
            /* Briefly SLEEP every 64 ops so LOWER-priority system threads get CPU time.
             * ROOT CAUSE of a long-standing hang: the benchmark runs in main() at a
             * priority >= system threads. k_yield() only yields to equal/higher-priority
             * threads, so the lower-priority WATCHDOG-FEEDER thread was starved during a
             * long tight compute loop -> the hardware watchdog was never fed -> the board
             * reset/wedged at its ~28 s timeout (512x5 @18s survived, 768x5 @28s did not).
             * k_sleep() actually blocks main so the feeder (and USB) run. It is OUTSIDE the
             * timed region (each op already recorded its elapsed time), so measurements are
             * unaffected -- it only adds a little wall-clock time to the run.
             * (Now also time-capped -- see mcu_maybe_yield -- so slow ops can't starve.) */
            mcu_maybe_yield(i);
        }
        k_sleep(K_MSEC(2));                        /* round boundary: let system threads run */
        mcu_yield_reset();
        if (n==0){
            MCU_EMIT("ROUND %ld group=%s mode=iters ok=0 ALL_OPS_FAILED discarded=%ld failed=%ld",
                     r, label, discarded, failed);
            continue;
        }
        if (discarded || failed){
            MCU_EMIT("WARN round=%ld group=%s kept=%ld of %ld discarded=%ld(>=25s) failed=%ld",
                     r, label, n, count, discarded, failed);
        }
        /* Welford mean/sd in ns */
        double mean=0,M2=0;
        for (long i=0;i<n;i++){ double d=(double)scratch[i]-mean; mean+=d/(i+1); M2+=d*((double)scratch[i]-mean); }
        double sd = n>1 ? sqrt(M2/(n-1)) : 0.0;
        qsort(scratch,n,sizeof(uint64_t),_mcu_cmp_u64);
        double mn=scratch[0], mx=scratch[n-1];
        double med=scratch[n/2], p95=scratch[(long)(n*0.95)];

        double div = unit_is_ms ? 1e6 : 1e3;   /* ns->ms or ns->us */
        /* Across-round central value = the per-round MEAN (our PRIMARY metric and the one
         * we compare on), NOT the median. Averaging medians was inconsistent with the
         * methodology and noisier (the median of a discrete-quantized sample jumps between
         * adjacent values round-to-round, which inflated the across-round SD on the longest
         * op, e.g. decaps-1024). */
        double central_val = mean/div;
        /* accumulate across-round (Welford on the per-round MEAN) */
        { double d=central_val-ar_mean; ar_n++; ar_mean+=d/ar_n; ar_M2+=d*(central_val-ar_mean); }

        if (unit_is_ms){
            MCU_EMIT("ROUND %ld group=%s mode=iters handshakes=%ld "
                     "ms_mean=%.4f ms_sd=%.4f ms_min=%.4f ms_med=%.4f ms_p95=%.4f ms_max=%.4f",
                     r,label,n, mean/div,sd/div,mn/div,med/div,p95/div,mx/div);
        } else {
            MCU_EMIT("ROUND %ld group=%s mode=iters iters=%ld "
                     "us_mean=%.4f us_sd=%.4f us_min=%.4f us_med=%.4f us_p95=%.4f us_max=%.4f",
                     r,label,n, mean/div,sd/div,mn/div,med/div,p95/div,mx/div);
        }
    }
    double ar_sd = ar_n>1 ? sqrt(ar_M2/(ar_n-1)) : 0.0;
    if (unit_is_ms)
        MCU_EMIT("AGG group=%s rounds=%ld across_round_mean_ms=%.4f across_round_sd_ms=%.4f",
                 label,rounds,ar_mean,ar_sd);
    else
        MCU_EMIT("AGG group=%s rounds=%ld across_round_mean_us=%.4f across_round_sd_us=%.4f",
                 label,rounds,ar_mean,ar_sd);
    (void)central;
}

/* ---- RAW SAMPLE DUMP (per-round streaming to the laptop) ----
 * Emits every sample of ONE round as integer NANOSECONDS so the laptop can compute the
 * TRUE mean/sd/min/max/median/p95/p99 over ALL rounds*count samples (percentiles cannot
 * be recovered from per-round summaries). Framing:
 *     RAWSTART round=<r> group=<label> n=<N> unit=ns
 *     SAMPLES <v> <v> ... (up to 16 per line, integer ns)
 *     ...
 *     RAWEND round=<r> group=<label> n=<N>
 * The laptop's integrity checks rely on this being byte-exact: min/max/count MUST match
 * the ROUND summary (strict), so we print raw integers (no rounding, no unit conversion).
 * This runs OUTSIDE the timed region (all samples already recorded), so it does not affect
 * measurements -- it only adds wall-clock transfer time between rounds. */
static void mcu_dump_raw(const char *label, long r, const uint64_t *scratch, long n)
{
    MCU_EMIT("RAWSTART round=%ld group=%s n=%ld unit=ns", r, label, n);
    /* build lines of up to 16 integers each */
    char line[256]; int pos; long i = 0;
    while (i < n) {
        pos = 0;
        pos += snprintf(line+pos, sizeof(line)-pos, "SAMPLES");
        for (int k = 0; k < 16 && i < n; k++, i++) {
            pos += snprintf(line+pos, sizeof(line)-pos, " %llu",
                            (unsigned long long)scratch[i]);
            if (pos >= (int)sizeof(line) - 24) { i++; break; } /* safety; shouldn't trigger */
        }
        mcu_print(line);
        /* PACE THE DUMP. A raw round is sent as many SAMPLES lines back-to-back; with no
         * gap the USB-CDC console TX ring fills faster than the USB ISR drains it and the
         * board wedges mid-dump (observed: silent board at 1000/round; occasional lost
         * round even at 200/round). A 1 ms sleep per line yields the CPU so the TX ISR
         * drains a full USB frame before the next line -> the ring never overflows. This
         * is OUTSIDE the timed region (all samples already recorded), so it does NOT affect
         * measurements; it only adds ~ (n/16) ms of transfer time per round (e.g. 1000
         * samples -> ~63 ms), which is negligible against multi-second compute rounds. */
        k_sleep(K_MSEC(1));
    }
    MCU_EMIT("RAWEND round=%ld group=%s n=%ld", r, label, n);
}

/* ---- SINGLE-ROUND runner (orchestrator-driven, design "b") ----
 * Runs EXACTLY ONE round: warmup (every round, per decision) + count timed ops, then emits
 *   (1) the ROUND summary line (doubles as the laptop's integrity cross-check: the laptop
 *       recomputes min/max/mean from the raw dump and compares -- min/max STRICT, mean eps),
 *   (2) the full RAW sample dump for that round.
 * The caller (orchestrator) issues one of these per round, validates, retries if needed,
 * and only advances when clean. The MCU never holds more than ONE round of samples. */
static void mcu_run_one_round(const char *label, int unit_is_ms, long round_idx,
                              long count, long warmup,
                              mcu_op_fn op, void *ctx,
                              uint64_t *scratch /* size >= count */,
                              mcu_reset_fn reset /* may be NULL */)
{
    if (count > 0 && reset && reset(ctx) != 0) {
        MCU_EMIT("ROUND %ld group=%s ok=0 RESET_FAILED", round_idx, label);
        return;
    }
    /* warmup EVERY round (decision): not timed, not stored, not dumped.
     * The yield clock spans warmup AND the timed loop, so the no-yield window can never exceed
     * MCU_YIELD_MAX_MS no matter how the ops split between the two (this was the hz3 p521 bug). */
    mcu_yield_reset();
    for (long i=0;i<warmup;i++){ uint64_t t; op(ctx,&t); mcu_maybe_yield(i); }

    long n=0, discarded=0, failed=0;
    for (long i=0;i<count;i++){
        uint64_t t;
        int rc = op(ctx,&t);
        if (rc == 0)        scratch[n++]=t;
        else if (rc == -2)  discarded++;
        else                failed++;
        mcu_maybe_yield(i);                            /* feed lower-prio threads */
    }
    k_sleep(K_MSEC(2));

    if (n==0){
        MCU_EMIT("ROUND %ld group=%s mode=iters ok=0 ALL_OPS_FAILED discarded=%ld failed=%ld",
                 round_idx, label, discarded, failed);
        return;
    }
    if (discarded || failed){
        MCU_EMIT("WARN round=%ld group=%s kept=%ld of %ld discarded=%ld(>=25s) failed=%ld",
                 round_idx, label, n, count, discarded, failed);
    }
    /* per-round summary (integrity cross-check source). Welford mean/sd in ns. */
    double mean=0,M2=0;
    for (long i=0;i<n;i++){ double d=(double)scratch[i]-mean; mean+=d/(i+1); M2+=d*((double)scratch[i]-mean); }
    double sd = n>1 ? sqrt(M2/(n-1)) : 0.0;
    qsort(scratch,n,sizeof(uint64_t),_mcu_cmp_u64);
    double mn=scratch[0], mx=scratch[n-1];
    double med=scratch[n/2], p95=scratch[(long)(n*0.95)];
    double div = unit_is_ms ? 1e6 : 1e3;
    if (unit_is_ms){
        MCU_EMIT("ROUND %ld group=%s mode=iters handshakes=%ld "
                 "ms_mean=%.4f ms_sd=%.4f ms_min=%.4f ms_med=%.4f ms_p95=%.4f ms_max=%.4f",
                 round_idx,label,n, mean/div,sd/div,mn/div,med/div,p95/div,mx/div);
    } else {
        MCU_EMIT("ROUND %ld group=%s mode=iters iters=%ld "
                 "us_mean=%.4f us_sd=%.4f us_min=%.4f us_med=%.4f us_p95=%.4f us_max=%.4f",
                 round_idx,label,n, mean/div,sd/div,mn/div,med/div,p95/div,mx/div);
    }
    /* raw dump AFTER the summary, then the caller advances and the buffer is reused */
    mcu_dump_raw(label, round_idx, scratch, n);
    MCU_EMIT("ROUNDDONE round=%ld group=%s n=%ld", round_idx, label, n);
}

/* Energy/time mode: run for window_ms wall-clock, count ops, emit a PAIR_WITH_METER
 * line so an external meter reading (mAh over the same window) maps to op count.
 * Mirrors the Pi harness PAIR_WITH_METER semantics. */
static void mcu_run_time(const char *label, int unit_is_ms,
                         long window_ms, long warmup,
                         mcu_op_fn op, void *ctx)
{
    mcu_yield_reset();
    for (long i=0;i<warmup;i++){ uint64_t t; op(ctx,&t); mcu_maybe_yield(i); }
    uint64_t t0=mcu_now_us(); long ok=0,att=0;
    uint64_t win_us=(uint64_t)window_ms*1000ull;
    /* LATENT BUG FIXED: this loop never yielded, so any energy window longer than the RP2350
     * no-yield threshold (~25 s) would have wedged the board. Time-only yield: 1 ms per
     * MCU_YIELD_MAX_MS keeps idle time ~0.01% so energy/op is not disturbed. */
    mcu_yield_reset();
    while (mcu_now_us()-t0 < win_us){ uint64_t t; if(op(ctx,&t)==0) ok++; att++; mcu_maybe_yield_time(); }
    double el_s=(mcu_now_us()-t0)/1e6;
    MCU_EMIT("ROUND 0 group=%s mode=time elapsed_s=%.4f attempts=%ld ok=%ld ops_per_s=%.3f %s=%.4f",
             label,el_s,att,ok, ok/el_s,
             unit_is_ms?"ms_per_op":"us_per_op",
             unit_is_ms ? (ok?el_s/ok*1e3:0.0) : (ok?el_s/ok*1e6:0.0));
    MCU_EMIT("PAIR_WITH_METER round=0 window_s=%.4f ops=%ld (read mAh on the meter)", el_s, ok);
}

#endif /* MCU_MEASURE_CORE_H */
```

## src/pqc_reloc_anchor.c
```c
/* pqc_reloc_anchor.c -- only built for the tables-only hybrid (PQC_HYB_PART=tables, m4).
 *
 * Zephyr's Arm MPU code (arch/arm/core/mpu/arm_core_mpu.c) and main.c's fault tests refer to the
 * relocated-code symbols __ram_text_reloc_start / _size, which the linker only defines when some
 * code is relocated. A tables-only image relocates no wolfSSL code, so it failed to link
 * (2026-11-11). This one tiny function is relocated instead: it gives the image a minimal
 * (32-byte MPU region) read-only + executable code block, which the W^X tests then attack like
 * any other code block. It is never called by the benchmark. */
#include <stdint.h>

__attribute__((used, noinline)) uint32_t pqc_reloc_anchor(uint32_t x)
{
	return x + 1u;
}
```
